## main/Kconfig.projbuild
```kconfig
menu "Example Configuration"

    config EXAMPLE_QUIET_LOGS
        bool "Quiet logs (force INFO level at boot)"
        default y
        help
            Force the runtime log level to INFO at the very start of app_main,
            regardless of what CONFIG_LOG_DEFAULT_LEVEL ended up in a stale
            sdkconfig. Excessive per-event DEBUG logging saturates the 115200
            baud console and slows everything down. sdkconfig.defaults alone is
            not enough: it is only applied when sdkconfig is regenerated.
            Disable only for deep diagnostics with a fast console.

    choice
        prompt "Choose the color format of the LCD"
        default LCD_PIXEL_FORMAT_RGB565
            config LCD_PIXEL_FORMAT_RGB565
                bool "RGB565"

            config LCD_PIXEL_FORMAT_RGB888
                bool "RGB888"
    endchoice

endmenu

menu "CamBrowser (Ethernet Browser on LCD)"

    config EB_ETH_MDC_GPIO
        int "IP101 SMI MDC GPIO"
        default 31

    config EB_ETH_MDIO_GPIO
        int "IP101 SMI MDIO GPIO"
        default 52

    config EB_ETH_RMII_CLK_GPIO
        int "RMII REF_CLK GPIO (50 MHz input from the PHY)"
        default 50

    config EB_ETH_RST_GPIO
        int "IP101 reset GPIO (active low, -1 = none)"
        default 51

    config EB_ETH_PHY_ADDR
        int "IP101 SMI address"
        default 1
        range 0 31

    config EB_ETH_ENABLE
        bool "Enable Ethernet (IP101 / internal EMAC)"
        default y
        help
            Wired Ethernet on JC1060P470C (IP101 RMII). Can run together with Wi-Fi.

    config EB_WIFI_ENABLE
        bool "Enable Wi-Fi via ESP32-C6 (esp_hosted)"
        default n
        help
            ESP32-P4 has no radio. Wi-Fi 6 is provided by the on-board ESP32-C6
            over SDIO (esp_hosted + esp_wifi_remote). Set SSID/password below.
            Note: microSD may share SDIO resources — prefer Ethernet+SD or Wi-Fi without SD.

    config EB_WIFI_SSID
        string "Wi-Fi SSID"
        depends on EB_WIFI_ENABLE
        default "myssid"
        help
            2.4 GHz network name (C6 is 2.4 GHz only).

    config EB_WIFI_PASSWORD
        string "Wi-Fi password"
        depends on EB_WIFI_ENABLE
        default "mypassword"
        help
            WPA2-PSK password.

    config EB_TOUCH_I2C_PORT
        int "Touch I2C port"
        default 1

    config EB_TOUCH_I2C_SCL
        int "Touch I2C SCL GPIO"
        default 8

    config EB_TOUCH_I2C_SDA
        int "Touch I2C SDA GPIO"
        default 7

    config EB_TOUCH_RST_GPIO
        int "Touch controller reset GPIO (-1 = not wired)"
        default 5

    config EB_TOUCH_INT_GPIO
        int "Touch INT GPIO (GT911 address select, -1 = floating)"
        default -1

    config EB_TOUCH_SWAP_XY
        bool "Touch: swap X/Y"
        default n

    config EB_TOUCH_MIRROR_X
        bool "Touch: mirror X"
        default n

    config EB_TOUCH_MIRROR_Y
        bool "Touch: mirror Y"
        default n

    choice EB_SEARCH_ENGINE
        prompt "Search engine"
        default EB_ENGINE_DUCKDUCKGO

        config EB_ENGINE_DUCKDUCKGO
            bool "DuckDuckGo (html endpoint)"

        config EB_ENGINE_GOOGLE
            bool "Google (best-effort)"
    endchoice

    config EB_MAX_BODY_KB
        int "Max HTTP body size (KB)"
        default 384
        range 64 1024

    menu "Audio / Media (radio and video player)"
        config EB_MEDIA_ENABLE
            bool "Enable radio and video player (media subsystem)"
            default y

        config EB_AUDIO_I2S_PORT
            int "I2S port for the audio output"
            default 0

        config EB_AUDIO_I2S_DOUT
            int "I2S DOUT (data to codec) GPIO"
            default 9

        config EB_AUDIO_I2S_LRCK
            int "I2S LRCK / word select GPIO"
            default 10

        config EB_AUDIO_I2S_BCLK
            int "I2S BCLK GPIO"
            default 12

        config EB_AUDIO_I2S_MCLK
            int "I2S MCLK GPIO (-1 = not wired)"
            default 13

        config EB_AUDIO_PA_GPIO
            int "Speaker power amplifier enable GPIO (-1 = always on)"
            default 11

        config EB_AUDIO_PA_ACTIVE_HIGH
            bool "Speaker amplifier enable is active high"
            default y

        config EB_AUDIO_CODEC_ADDR
            hex "ES8311 I2C address (8-bit write address)"
            default 0x30

        config EB_SD_ENABLE
            bool "Enable SD card (media files from microSD)"
            default y

        config EB_SD_MOUNT
            string "SD mount point"
            default "/sdcard"

        config EB_SD_MAX_FREQ_KHZ
            int "SD bus max frequency (kHz)"
            default 20000
            range 400 40000

        config EB_SD_LDO_CHAN
            int "On-chip LDO channel powering the card IO"
            default 4

        config EB_SD_CLK_GPIO
            int "SD CLK GPIO"
            default 43

        config EB_SD_CMD_GPIO
            int "SD CMD GPIO"
            default 44

        config EB_SD_D0_GPIO
            int "SD D0 GPIO"
            default 39

        config EB_SD_D1_GPIO
            int "SD D1 GPIO"
            default 40

        config EB_SD_D2_GPIO
            int "SD D2 GPIO"
            default 41

        config EB_SD_D3_GPIO
            int "SD D3 GPIO"
            default 42
    endmenu

endmenu

menu "Example Boards Types"

    choice
        prompt "Choose the Boards Types"
        default BOARD_TYPE_JC1060P470
            config BOARD_TYPE_JC4880P443
                bool "JC4880P4433"

            config BOARD_TYPE_JC8012P4A1
                bool "JC8012P4A1"
            config BOARD_TYPE_JC1060P470
                bool "JC1060P470"
    endchoice

endmenu
```
