/*
 * SPDX-FileCopyrightText: 2026
 *
 * SPDX-License-Identifier: CC0-1.0
 *
 * FPS overlay for the camera viewfinder.
 *
 * Renders a small "FPS: 30.1" text in the top-left corner of the LCD
 * frame buffer (RGB565), on top of the camera image, after the PPA
 * blit and before esp_lcd_panel_draw_bitmap().
 *
 * Font: font8x8 (public domain, Daniel Hepper / Marcel Sondaar,
 * based on public domain IBM VGA fonts). Bit 0 of every row byte is
 * the leftmost pixel.
 */

#include <stdio.h>
#include <stdint.h>
#include <string.h>
#include "app_overlay.h"

#define FONT_W          8
#define FONT_H          8
#define OVERLAY_SCALE   3   /* glyph pixel size: 8x8 -> 24x24 per char */
#define OVERLAY_PAD     6   /* black box padding around the text, px */

/* ASCII 0x20..0x7E, one byte per row, LSB = leftmost pixel.
 * Non-static so the CamBrowser UI (camos/ui.c) reuses the same glyphs. */
const uint8_t app_overlay_font8x8[95][8] = {
    { 0x00, 0x00, 0x00, 0x00, 0x00, 0x00, 0x00, 0x00 },   /* 0x20   */
    { 0x18, 0x3C, 0x3C, 0x18, 0x18, 0x00, 0x18, 0x00 },   /* 0x21 \x21 */
    { 0x36, 0x36, 0x00, 0x00, 0x00, 0x00, 0x00, 0x00 },   /* 0x22 \x22 */
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    { 0x6E, 0x3B, 0x00, 0x00, 0x00, 0x00, 0x00, 0x00 },   /* 0x7E \x7e */
};

/* Map ASCII code to the font table index, -1 if not present */
static int font_index(char c)
{
    if (c < 0x20 || c > 0x7E) {
        return -1;
    }
    return c - 0x20;
}

static const uint8_t *font_glyph(char c)
{
    int idx = font_index(c);
    return (idx >= 0) ? app_overlay_font8x8[idx] : app_overlay_font8x8['?' - 0x20];
}

static void fill_rect_rgb565(uint16_t *fb, int fb_w, int fb_h,
                             int x0, int y0, int x1, int y1, uint16_t color)
{
    if (x0 < 0) x0 = 0;
    if (y0 < 0) y0 = 0;
    if (x1 > fb_w) x1 = fb_w;
    if (y1 > fb_h) y1 = fb_h;

    for (int y = y0; y < y1; y++) {
        uint16_t *row = fb + (size_t)y * fb_w + x0;
        for (int x = x0; x < x1; x++) {
            *row++ = color;
        }
    }
}

static void draw_char_rgb565(uint16_t *fb, int fb_w, int fb_h,
                             int x, int y, char c, int scale,
                             uint16_t fg, uint16_t bg)
{
    const uint8_t *glyph = font_glyph(c);

    for (int row = 0; row < FONT_H; row++) {
        for (int col = 0; col < FONT_W; col++) {
            uint16_t color = (glyph[row] >> col) & 0x1 ? fg : bg;
            int px = x + col * scale;
            int py = y + row * scale;
            fill_rect_rgb565(fb, fb_w, fb_h, px, py, px + scale, py + scale, color);
        }
    }
}

static void draw_string_rgb565(uint16_t *fb, int fb_w, int fb_h,
                               int x, int y, const char *s, int scale,
                               uint16_t fg, uint16_t bg)
{
    int step = FONT_W * scale;
    for (const char *p = s; *p; p++, x += step) {
        draw_char_rgb565(fb, fb_w, fb_h, x, y, *p, scale, fg, bg);
    }
}

void app_overlay_draw_fps(uint16_t *fb, int fb_w, int fb_h, float fps)
{
    if (fb == NULL || fb_w <= 0 || fb_h <= 0) {
        return;
    }
    if (fps < 0.0f || fps > 999.9f) {
        fps = 999.9f;
    }

    char line[24];
    int whole = (int)fps;
    int tenth = (int)(fps * 10.0f) % 10;
    snprintf(line, sizeof(line), "FPS:%3d.%d", whole, tenth);

    int text_w = (int)strlen(line) * FONT_W * OVERLAY_SCALE;
    int text_h = FONT_H * OVERLAY_SCALE;
    int x0 = 8;
    int y0 = 8;

    /* black box behind the text for readability over a live image */
    fill_rect_rgb565(fb, fb_w, fb_h,
                     x0, y0,
                     x0 + text_w + 2 * OVERLAY_PAD,
                     y0 + text_h + 2 * OVERLAY_PAD,
                     0x0000);

    draw_string_rgb565(fb, fb_w, fb_h,
                       x0 + OVERLAY_PAD, y0 + OVERLAY_PAD,
                       line, OVERLAY_SCALE,
                       0xFFFF /* white */, 0x0000 /* black */);
}

/* --- Cyrillic (UTF-8 2-byte, CamBrowser UI) ---------------------------- */
/* 8x8 Cyrillic glyphs for CamBrowser.
 * Source: hand-designed console font Cyr_a8x8 (kbd package,
 * fonts/psf/Cyr_a8x8.psfu), converted by fonts/gen_cyr_from_psf.py.
 * Ё/ё composed from Е/е + dots (cp866 io positions are absent).
 * Bit0 = leftmost pixel, matching app_overlay_font8x8.
 * Index 0..31 = U+0410..U+042F (А..Я), 32..63 = U+0430..U+044F (а..я),
 * 64 = U+0401 (Ё), 65 = U+0451 (ё). */
const uint8_t app_overlay_font8x8_cyr[66][8] = {
    { 0x70, 0x78, 0x6C, 0x66, 0x7F, 0x63, 0x63, 0x00 },   /*  0 U+0410 А */
    { 0x3F, 0x03, 0x03, 0x3F, 0x63, 0x63, 0x3F, 0x00 },   /*  1 U+0411 Б */
    { 0x1F, 0x33, 0x33, 0x3F, 0x63, 0x63, 0x3F, 0x00 },   /*  2 U+0412 В */
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    { 0x22, 0x00, 0x1E, 0x33, 0x3F, 0x03, 0x3E, 0x00 },   /* 65 U+0451 ё */
};
